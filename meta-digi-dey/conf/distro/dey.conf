## meta-digi-dey/conf/distro/dey.conf
```bitbake
require conf/distro/poky.conf

# Discrete version values.
YOCTO_MAJOR = "5"
YOCTO_MINOR = "0"
DEY_RELEASE = "2"
DEY_BUILD = "2"

# Firmware version of the system.
DEY_FIRMWARE_VERSION ?= "${YOCTO_MAJOR}.${YOCTO_MINOR}.${DEY_RELEASE}.${DEY_BUILD}"

# Distribution info.
DISTRO = "dey"
DISTRO_NAME = "Digi Embedded Yocto"
DISTRO_VERSION = "${YOCTO_MAJOR}.${YOCTO_MINOR}-r${DEY_RELEASE}"

SDK_VENDOR = "-deysdk"

MAINTAINER = "Digi Support <tech.support@digi.com>"

TARGET_VENDOR = "-dey"

POKY_DEFAULT_EXTRA_RDEPENDS = "packagegroup-dey-core"
POKY_DEFAULT_EXTRA_RRECOMMENDS = ""

#
# Rework distro features for DEY distribution
#
MACHINE_DISTRO_FEATURES_ADD ?= ""
MACHINE_DISTRO_FEATURES_REMOVE ?= ""
DISTRO_FEATURES:append = " cellular gstreamer pam ${MACHINE_DISTRO_FEATURES_ADD}"
DISTRO_FEATURES:remove = "3g nfc nfs ptest zeroconf ${MACHINE_DISTRO_FEATURES_REMOVE}"

GRAPHICAL_BACKEND = "${@bb.utils.contains('DISTRO_FEATURES', 'x11 wayland', 'xwayland', \
                        bb.utils.contains('DISTRO_FEATURES', 'x11', 'x11', \
                        bb.utils.contains('DISTRO_FEATURES', 'wayland', 'wayland', 'fb', d), d), d)}"

# Recovery initramfs image name.
RECOVERY_INITRAMFS_IMAGE ?= "dey-image-recovery-initramfs"
# Add initramfs into FIT image
INITRAMFS_IMAGE = '${@bb.utils.contains("KERNEL_IMAGETYPE", "fitImage", "${RECOVERY_INITRAMFS_IMAGE}", "", d)}'

# DEY image features (alphabetical order)
FEATURE_PACKAGES_dey-audio = "packagegroup-dey-audio"
FEATURE_PACKAGES_dey-bluetooth = "packagegroup-dey-bluetooth"
FEATURE_PACKAGES_dey-debug = "packagegroup-dey-debug"
FEATURE_PACKAGES_dey-examples = "packagegroup-dey-examples"
FEATURE_PACKAGES_dey-flutter = "packagegroup-dey-flutter"
FEATURE_PACKAGES_dey-gstreamer = "packagegroup-dey-gstreamer"
FEATURE_PACKAGES_dey-lvgl = "packagegroup-dey-lvgl"
FEATURE_PACKAGES_dey-network = "packagegroup-dey-network"
FEATURE_PACKAGES_dey-qt = "packagegroup-dey-qt"
FEATURE_PACKAGES_dey-trustfence = "packagegroup-dey-trustfence"
FEATURE_PACKAGES_dey-webkit = "packagegroup-dey-webkit"
FEATURE_PACKAGES_dey-wireless = "packagegroup-dey-wireless"

# Our layer only provides version 5.41, which we want to keep because
# it was used for Bluetooth certification. However by default the newer
# 5.72 version should be used, which is provided by the poky layer.
PREFERRED_VERSION_bluez5 ?= "5.72"

# Latest version of libgpiod (2.1.1) breaks API compatibility with previously
# used version 1.6.3, causing libdigiapix compilation errors. Until we port
# libdigiapix to 2.1.1, use 1.6.4 instead, which is also available in poky to
# ensure compatibility with the old API.
PREFERRED_VERSION_libgpiod ?= "1.6.4"

# Starting in wpewebkit 2.46.1, our ConnectCore demo is broken due to clicks
# not being registered in the demo's main area. This doesn't happen in 2.44.4,
# so use that version while we look for a fix in the newer version.
PREFERRED_VERSION_wpewebkit ?= "2.44.4"

# There's a generic opencl-headers recipe in the thud branch of
# meta-openembedded, but we should use the package provided by the imx-gpu-viv
# recipe in case there are NXP-specific changes in it
PREFERRED_PROVIDER_opencl-headers ?= "imx-gpu-viv"

# Use the FDO backend for WPE WebKit
PREFERRED_PROVIDER_virtual/wpebackend = "wpebackend-fdo"

SDKPATHINSTALL = "/opt/${DISTRO}/${SDK_VERSION}/${MACHINE}"

# Some packages need this (e.g. gstreamer1.0-plugins-ugly)
LICENSE_FLAGS_ACCEPTED += "commercial"

# Use systemd init manager by default
INIT_MANAGER = "systemd"

# Enable examples for some QT packages
PACKAGECONFIG:append:class-target:pn-qtbase        = " examples"
PACKAGECONFIG:append:class-target:pn-qtdeclarative = " examples"
PACKAGECONFIG:append:class-target:pn-qtquick3d     = " examples"
PACKAGECONFIG:append:class-target:pn-qtwebengine   = " examples"

# Remove unnecessary libarchive configurations to trim down the recovery image,
# while keeping the "zlib" one to make sure our file update mechanism still
# works (libarchive needs to be able to handle .tar.gz files, every other
# format can be omitted).
PACKAGECONFIG:remove:class-target:pn-libarchive   = "bz2 xz lzo zstd acl xattr"

# cryptsetup still works as expected in our eMMC partition encryption use case
# when udev support is disabled, so remove it to avoid dragging a bunch of
# dependencies into the recovery and trustfence initramfs.
PACKAGECONFIG:remove:class-target:pn-cryptsetup = "udev"

# gstreamer's rsvg plugin is enabled by default in all of our platforms where
# gstreamer1.0-plugins-bad is used, which is most of them. This plugin depends
# on librsvg, a small library implemented in Rust. For some of our platforms,
# it's the only package in our default DEY images that requires bitbake to
# generate the Rust compiler, which is a lengthy process. Disable the gstreamer
# rsvg plugin to remove this dependency and the Rust compiler overhead.
PACKAGECONFIG:remove:pn-gstreamer1.0-plugins-bad = "rsvg"
```

## meta-digi-dey/conf/distro/include/time64.inc
```bitbake
# Copyright (C) 2024, Digi International Inc. 

# Specify global CFLAGS for target to support 64 bit time
GLIBC_64BIT_TIME_FLAGS = " -D_TIME_BITS=64 -D_FILE_OFFSET_BITS=64"

# Only needed for some 32-bit architectures
TARGET_CC_ARCH:append:arm = "${GLIBC_64BIT_TIME_FLAGS}"

# Do not apply the 64Bit compile flag for the following packages
# to avoid build errors
GLIBC_64BIT_TIME_FLAGS:pn-glibc = ""
GLIBC_64BIT_TIME_FLAGS:pn-kbd = ""
GLIBC_64BIT_TIME_FLAGS:pn-v4l-utils = ""
GLIBC_64BIT_TIME_FLAGS:pn-pulseaudio = ""
GLIBC_64BIT_TIME_FLAGS:pn-imx-gst1.0-plugin = ""
GLIBC_64BIT_TIME_FLAGS:pn-zlib = ""
```

## meta-digi-dey/conf/layer.conf
```bitbake
# We have a conf and classes directory, add to BBPATH
BBPATH .= ":${LAYERDIR}"

# We have a packages directory, add to BBFILES
BBFILES += "${LAYERDIR}/recipes-*/*/*.bb \
            ${LAYERDIR}/recipes-*/*/*.bbappend"

BBFILES_DYNAMIC += " \
    webkit:${LAYERDIR}/dynamic-layers/webkit/*/*/*.bb \
    webkit:${LAYERDIR}/dynamic-layers/webkit/*/*/*.bbappend \
    selinux:${LAYERDIR}/dynamic-layers/selinux/*/*/*.bb \
    selinux:${LAYERDIR}/dynamic-layers/selinux/*/*/*.bbappend \
    freescale-layer:${LAYERDIR}/dynamic-layers/freescale-layer/*/*/*.bb \
    freescale-layer:${LAYERDIR}/dynamic-layers/freescale-layer/*/*/*.bbappend \
    imx-machine-learning:${LAYERDIR}/dynamic-layers/imx-machine-learning/*/*/*.bb \
    imx-machine-learning:${LAYERDIR}/dynamic-layers/imx-machine-learning/*/*/*.bbappend \
    stm-st-stm32mp:${LAYERDIR}/dynamic-layers/stm-st-stm32mp/*/*/*.bb \
    stm-st-stm32mp:${LAYERDIR}/dynamic-layers/stm-st-stm32mp/*/*/*.bbappend \
    x-linux-ai:${LAYERDIR}/dynamic-layers/x-linux-ai/*/*/*.bb \
    x-linux-ai:${LAYERDIR}/dynamic-layers/x-linux-ai/*/*/*.bbappend \
    x-linux-ai:${LAYERDIR}/dynamic-layers/x-linux-ai/*/*/*/*.bb \
    x-linux-ai:${LAYERDIR}/dynamic-layers/x-linux-ai/*/*/*/*.bbappend \
    qt5-layer:${LAYERDIR}/dynamic-layers/qt5-layer/*/*/*.bb \
    qt5-layer:${LAYERDIR}/dynamic-layers/qt5-layer/*/*/*.bbappend \
    qt5-layer:${LAYERDIR}/dynamic-layers/qt5-layer/${DEY_SOC_VENDOR}/*/*/*.bb \
    qt5-layer:${LAYERDIR}/dynamic-layers/qt5-layer/${DEY_SOC_VENDOR}/*/*/*.bbappend \
    qt6-layer:${LAYERDIR}/dynamic-layers/qt6-layer/*/*/*.bb \
    qt6-layer:${LAYERDIR}/dynamic-layers/qt6-layer/*/*/*.bbappend \
    qt6-layer:${LAYERDIR}/dynamic-layers/qt6-layer/${DEY_SOC_VENDOR}/*/*/*.bb \
    qt6-layer:${LAYERDIR}/dynamic-layers/qt6-layer/${DEY_SOC_VENDOR}/*/*/*.bbappend \
    flutter-apps-layer:${LAYERDIR}/dynamic-layers/flutter-apps-layer/*/*/*/*.bb \
    flutter-apps-layer:${LAYERDIR}/dynamic-layers/flutter-apps-layer/*/*/*/*.bbappend \
"

BBFILE_COLLECTIONS += "digi-dey"
BBFILE_PATTERN_digi-dey := "^${LAYERDIR}/"
BBFILE_PRIORITY_digi-dey = "6"

LAYERDEPENDS_digi-dey  = "core digi-arm"
LAYERDEPENDS_digi-dey += "openembedded-layer networking-layer webserver swupdate"

LAYERSERIES_COMPAT_digi-dey = "scarthgap"

META_DIGI_SCRIPTS = "${LAYERDIR}/../scripts"

# Digi's General and Open Source license agreements
DIGI_EULA_FILE = "${LAYERDIR}/DIGI_EULA"
DIGI_OPEN_EULA_FILE = "${LAYERDIR}/DIGI_OPEN_EULA"

# Digi mirror for packages vanished upstream
DIGI_MIRROR ?= "https://ftp1.digi.com/support/digiembeddedyocto/mirror/"
MIRRORS += "\
ftp://.*/.*      ${DIGI_MIRROR} \n \
http://.*/.*     ${DIGI_MIRROR} \n \
https://.*/.*    ${DIGI_MIRROR} \n \
"
```
