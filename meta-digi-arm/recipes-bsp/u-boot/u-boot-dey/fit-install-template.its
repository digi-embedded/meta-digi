## meta-digi-arm/recipes-bsp/u-boot/u-boot-dey/fit-install-template.its
```
/dts-v1/;

/ {
        description = "Installer fitImage for Digi Embedded Yocto";
        #address-cells = <1>;

        images {
                ##INSTALL_LINUX_FW## {
                        description = "U-boot ##INSTALL_LINUX_FW_DEV## installer script";
                        data = /incbin/("##INSTALL_LINUX_FW_FILE##.fit");
                        type = "script";
                        arch = "arm";
                        compression = "none";
                        hash-1 {
                                algo = "sha256";
                        };
                        signature-1 {
                                algo = "sha256,rsa2048";
                                key-name-hint = "fitimg";
                        };
                };
        };

        configurations {
                default = "conf-##INSTALL_LINUX_FW##";
                conf-##INSTALL_LINUX_FW## {
                        description = "u-boot ##INSTALL_LINUX_FW_DEV## installer script";

                        bootscr = "##INSTALL_LINUX_FW##";

                        hash-1 {
                                algo = "sha256";
                        };
                        signature-1 {
                                algo = "sha256,rsa2048";
                                key-name-hint = "fitcfg";
                                padding = "pkcs-1.5";
                                sign-images = "bootscr";
                        };
                };
        };
};
```

## meta-digi-containers/conf/layer.conf
```bitbake
# We have a conf and classes directory, add to BBPATH
BBPATH .= ":${LAYERDIR}"

# Container recipes and bbappends
BBFILES += "${LAYERDIR}/recipes-*/*/*.bb \
            ${LAYERDIR}/recipes-*/*/*.bbappend"

BBFILE_COLLECTIONS += "digi-containers"
BBFILE_PATTERN_digi-containers := "^${LAYERDIR}/"
BBFILE_PRIORITY_digi-containers = "7"

LAYERDEPENDS_digi-containers = "digi-dey virtualization-layer"
LAYERSERIES_COMPAT_digi-containers = "scarthgap"
```

## meta-digi-dey/conf/distro/maintenance.inc
```bitbake
# Use new NXP package mirror
FSL_MIRROR = "https://www.nxp.com/lgfiles/NMG/MAD/YOCTO/"

# Use GNU mirror instead of main server for GNU packages
GNU_MIRROR = "https://ftpmirror.gnu.org/gnu"

SRC_URI_prepend_pn-c-ares = "https://c-ares.org/archive/${BP}.tar.gz "
SRC_URI_remove_pn-c-ares = "http://c-ares.haxx.se/download/${BP}.tar.gz"
SRC_URI_prepend_pn-gdb = "${GNU_MIRROR}/gdb/gdb-${PV}.tar.xz "
SRC_URI_remove_pn-gdb = "http://ftp.gnu.org/gnu/gdb/gdb-${PV}.tar.xz"
SRC_URI_prepend_pn-libconfig = "https://sources.buildroot.net/${BPN}/${BP}.tar.gz "
SRC_URI_remove_pn-libconfig = "http://www.hyperrealm.com/${BPN}/${BP}.tar.gz"
SRC_URI_prepend_pn-lvm2 = "https://sourceware.org/pub/lvm2/old/LVM2.${PV}.tgz "
SRC_URI_remove_pn-lvm2 = "ftp://sources.redhat.com/pub/lvm2/old/LVM2.${PV}.tgz"
SRC_URI_prepend_pn-puzzles = "git://git.tartarus.org/simon/puzzles.git;branch=main "
SRC_URI_remove_pn-puzzles = "git://git.tartarus.org/simon/puzzles.git"
SRC_URI_prepend_pn-qtsmarthome = "https://artifacts.toradex.com/artifactory/tdxref-oe-prod-frankfurt/dunfell-5.x.y/release/4/sources/smarthome_src.tar.gz "
SRC_URI_remove_pn-qtsmarthome = "http://share.basyskom.com/demos/smarthome_src.tar.gz"
SRC_URI_prepend_pn-thin-provisioning-tools = "git://github.com/jthornber/thin-provisioning-tools;branch=main "
SRC_URI_remove_pn-thin-provisioning-tools = "git://github.com/jthornber/thin-provisioning-tools"
SRC_URI_prepend_pn-x264 = "git://github.com/mirror/x264.git;protocol=https;branch=stable "
SRC_URI_remove_pn-x264 = "git://git.videolan.org/x264.git"
```
