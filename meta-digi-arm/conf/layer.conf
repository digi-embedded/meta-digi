## meta-digi-arm/conf/machine/ccimx8mn-dvk.conf
```bitbake
#@TYPE: Machine
#@NAME: ConnectCore 8M Nano Development Kit.
#@DESCRIPTION: Machine configuration for Digi's ConnectCore 8M Nano DVK.

DIGI_SOM = "ccimx8mn"
MACHINEOVERRIDES =. "mx8:mx8m:mx8mn:${DIGI_FAMILY}:${DIGI_SOM}:"

# Include the machine configuration for Digi's ConnectCore 8M module.
include conf/machine/include/ccimx8m.inc

BOOTLOADER_SEEK_USERDATA = "32"

# U-Boot configurations
#
# At the moment config label should be "machine" because SDIMG_BOOTLOADER
# expects a boot artifact named after machine to create the sdcard image.
UBOOT_CONFIG ??= "ccimx8mn-dvk"
UBOOT_CONFIG[ccimx8mn-dvk] = "ccimx8mn_dvk_defconfig"
SPL_BINARY = "spl/u-boot-spl.bin"

# Set u-boot DTB
UBOOT_DTB_NAME = "ccimx8mn-dvk.dtb"

# Index of USB device for installer
UBOOT_INSTALL_USB_INDEX = "0"
# Index of microSD device for installer
UBOOT_INSTALL_SD_INDEX = "1"

ATF_PLATFORM = "imx8mn"
IMX_BOOT_SOC_TARGET = "iMX8MN"

KERNEL_DEVICETREE ?= " \
    digi/ccimx8m_bt.dtbo \
    digi/ccimx8mn_cm7.dtbo \
    digi/ccimx8m_mca-keypad.dtbo \
    digi/ccimx8mn_v1.dtbo \
    digi/ccimx8m_wifi.dtbo \
    digi/ccimx8m-dvk_flexspi.dtbo \
    digi/ccimx8m-dvk_gpio-watchdog.dtbo \
    digi/ccimx8m-dvk_hsd101pfw2-lvds.dtbo \
    digi/ccimx8m-dvk_lvds.dtbo \
    digi/ccimx8m-dvk_user-leds.dtbo \
    digi/ccimx8mn-dvk_v1-v2.dtbo \
    digi/ccimx8mn-dvk.dtb \
"
FIT_CONF_DEFAULT_DTB = "ccimx8mn-dvk.dtb"

SERIAL_CONSOLES ?= "115200;ttymxc0"

# Bluetooth tty
BT_TTY ?= "ttymxc1"

# XBees
XBEE_RESET_N_GPIO ?= "mca-gpio@15,gpio1@8"
XBEE_SLEEP_RQ_GPIO ?= "mca-gpio@11,gpio1@7"
XBEE_TTY ?= "ttymxc3"

# Boot artifacts to be copied from the deploy dir to the installer ZIP
BOOTABLE_ARTIFACTS = "imx-boot##SIGNED##-ccimx8mn-dvk.bin"

# Default overlayfs_etc mount point and type
OVERLAYFS_ETC_MOUNT_POINT ?= "/mnt/data"
OVERLAYFS_ETC_DEVICE ?= "/dev/mmcblk0p7"
OVERLAYFS_ETC_FSTYPE ?= "ext4"
```

## meta-digi-arm/conf/machine/ccimx8mp-dvk.conf
```bitbake
#@TYPE: Machine
#@NAME: ConnectCore 8M Plus Development Kit.
#@DESCRIPTION: Machine configuration for Digi's ConnectCore 8M Plus DVK.

# Include the machine configuration for Digi's ConnectCore 8M module.
include conf/machine/include/ccimx8m.inc

# Temporarily remove wifi and bluetooth machine features until
# we have proper support for the Murata module.
MACHINE_FEATURES:remove = "wifi bluetooth"

DIGI_FAMILY = "ccimx8mp"
MACHINEOVERRIDES =. "mx8:mx8m:mx8mp:ccimx8m:${DIGI_FAMILY}:"

BOOTLOADER_SEEK = "32"

# U-Boot configurations
# Last one is the default (the one the symlinks point at)
UBOOT_CONFIG ??= "ccimx8mp_dvk"
UBOOT_CONFIG[ccimx8mp_dvk] = "ccimx8mp_dvk_defconfig,,u-boot-dtb.${UBOOT_SUFFIX}"

# Set DDR FIRMWARE
DDR_FIRMWARE_VERSION = "202006"
DDR_FIRMWARE_NAME = " \
    lpddr4_pmu_train_1d_dmem_${DDR_FIRMWARE_VERSION}.bin \
    lpddr4_pmu_train_1d_imem_${DDR_FIRMWARE_VERSION}.bin \
    lpddr4_pmu_train_2d_dmem_${DDR_FIRMWARE_VERSION}.bin \
    lpddr4_pmu_train_2d_imem_${DDR_FIRMWARE_VERSION}.bin \
"

SPL_BINARY = "spl/u-boot-spl.bin"

# Set u-boot DTB
UBOOT_DTB_NAME = "ccimx8mp-dvk.dtb"

ATF_PLATFORM = "imx8mp"

KERNEL_DEVICETREE ?= " \
    digi/ccimx8mp-dvk.dtb \
"

SERIAL_CONSOLES ?= "115200;ttymxc0"

# Bluetooth tty
BT_TTY ?= "ttymxc1"

# XBees
XBEE_RESET_N_GPIO ?= "mca-gpio@15,gpio1@8"
XBEE_SLEEP_RQ_GPIO ?= "mca-gpio@11,gpio1@7"
XBEE_TTY ?= "ttymxc3"

# Image FS types
IMAGE_FSTYPES ?= '${@bb.utils.contains("IMAGE_FEATURES", "read-only-rootfs", \
				       "boot.vfat tar.bz2 recovery.vfat squashfs", \
				       "boot.vfat ext4.gz sdcard.gz tar.bz2 recovery.vfat", d)}'
```

## meta-digi-arm/conf/machine/ccimx8x-sbc-express.conf
```bitbake
#@TYPE: Machine
#@NAME: ConnectCore 8X Single Board Computer Express.
#@DESCRIPTION: Machine configuration for Digi's ConnectCore 8X SBC Express.

# Include the machine configuration for Digi's ConnectCore 8X module.
include conf/machine/include/ccimx8x.inc

# U-Boot configurations
UBOOT_CONFIG ??= "ccimx8x_sbc_express"
UBOOT_CONFIG[ccimx8x_sbc_express] = "ccimx8x_sbc_express_defconfig,,u-boot-dtb.${UBOOT_SUFFIX}"
SPL_BINARY = "spl/u-boot-spl.bin"
# Index of USB device for installer
UBOOT_INSTALL_USB_INDEX = "0"
# Index of microSD device for installer
UBOOT_INSTALL_SD_INDEX = "1"

KERNEL_DEVICETREE ?= " \
    digi/ccimx8x_bt.dtbo \
    digi/ccimx8x_quad.dtbo \
    digi/ccimx8x_wifi.dtbo \
    digi/ccimx8x-sbc-express.dtb \
"
FIT_CONF_DEFAULT_DTB = "ccimx8x-sbc-express.dtb"

SERIAL_CONSOLES ?= "115200;ttyLP2"

# Bluetooth tty
BT_TTY ?= "ttyLP1"

# XBee
XBEE_RESET_N_GPIO ?= "gpio3@13"
XBEE_SLEEP_RQ_GPIO ?= "gpio3@16"
XBEE_TTY ?= "ttyLP0"

# Boot artifacts to be copied from the deploy dir to the installer ZIP
BOOTABLE_ARTIFACTS = " \
    imx-boot##SIGNED##-ccimx8x-sbc-express-B0.bin \
    imx-boot##SIGNED##-ccimx8x-sbc-express-C0.bin \
"
```

## meta-digi-arm/conf/machine/ccimx8x-sbc-pro.conf
```bitbake
#@TYPE: Machine
#@NAME: ConnectCore 8X Single Board Computer Pro.
#@DESCRIPTION: Machine configuration for Digi's ConnectCore 8X SBC Pro.

# Include the machine configuration for Digi's ConnectCore 8X module.
include conf/machine/include/ccimx8x.inc

# U-Boot configurations
# Last one is the default (the one the symlinks point at)
UBOOT_CONFIG ??= "ccimx8x_sbc_pro"
UBOOT_CONFIG[ccimx8x_sbc_pro] = "ccimx8x_sbc_pro_defconfig,,u-boot-dtb.${UBOOT_SUFFIX}"
SPL_BINARY = "spl/u-boot-spl.bin"
# Index of USB device for installer
UBOOT_INSTALL_USB_INDEX = "0"
# Index of microSD device for installer
UBOOT_INSTALL_SD_INDEX = "1"

KERNEL_DEVICETREE ?= " \
    digi/ccimx8x_bt.dtbo \
    digi/ccimx8x_cm4.dtbo \
    digi/ccimx8x_mca-keypad.dtbo \
    digi/ccimx8x_quad.dtbo \
    digi/ccimx8x_wifi.dtbo \
    digi/ccimx8x-sbc-pro_flexcan1.dtbo \
    digi/ccimx8x-sbc-pro_flexspi.dtbo \
    digi/ccimx8x-sbc-pro_gpio-watchdog.dtbo \
    digi/ccimx8x-sbc-pro_hsd101pfw2-lvds.dtbo \
    digi/ccimx8x-sbc-pro_lpuart3.dtbo \
    digi/ccimx8x-sbc-pro_lt8912-hdmi-dsi0.dtbo \
    digi/ccimx8x-sbc-pro_lvds1.dtbo \
    digi/ccimx8x-sbc-pro_parallel-camera.dtbo \
    digi/ccimx8x-sbc-pro_pcie-card.dtbo \
    digi/ccimx8x-sbc-pro_pcie-modem.dtbo \
    digi/ccimx8x-sbc-pro_user-leds.dtbo \
    digi/ccimx8x-sbc-pro_v1-v3.dtbo \
    digi/ccimx8x-sbc-pro.dtb \
"
FIT_CONF_DEFAULT_DTB = "ccimx8x-sbc-pro.dtb"

SERIAL_CONSOLES ?= "115200;ttyLP2"

# Bluetooth tty
BT_TTY ?= "ttyLP1"

# XBee
XBEE_RESET_N_GPIO ?= "mca-gpio@15"
XBEE_SLEEP_RQ_GPIO ?= "mca-gpio@11"
XBEE_TTY ?= "ttyMCA0"

# Boot artifacts to be copied from the deploy dir to the installer ZIP
BOOTABLE_ARTIFACTS = " \
    imx-boot##SIGNED##-ccimx8x-sbc-pro-B0.bin \
    imx-boot##SIGNED##-ccimx8x-sbc-pro-C0.bin \
"

# Default overlayfs_etc mount point and type
OVERLAYFS_ETC_MOUNT_POINT ?= "/mnt/data"
OVERLAYFS_ETC_DEVICE ?= "/dev/mmcblk0p7"
OVERLAYFS_ETC_FSTYPE ?= "ext4"
```

## meta-digi-arm/conf/machine/ccimx91-dvk.conf
```bitbake
#@TYPE: Machine
#@NAME: ConnectCore 91 Development Kit
#@DESCRIPTION: Machine configuration for Digi's ConnectCore 91 DVK

DIGI_SOM = "ccimx91"
MACHINEOVERRIDES =. "mx91:${DIGI_FAMILY}:${DIGI_SOM}:"

# Include the machine configuration for Digi's ConnectCore 9 module
include conf/machine/include/ccimx9.inc

IMXBOOT_TARGETS = "flash_singleboot"

# U-Boot configurations
UBOOT_CONFIG ??= "ccimx91-dvk"
UBOOT_CONFIG[ccimx91-dvk] = "ccimx91-dvk_defconfig"

# Index of USB device for installer
UBOOT_INSTALL_USB_INDEX = "0"
# Index of microSD device for installer
UBOOT_INSTALL_SD_INDEX = "1"

# imx-boot configurations
ATF_PLATFORM = "imx91"
IMX_BOOT_SOC_TARGET = "iMX91"
IMXBOOT_TARGETS = "flash_singleboot"
SECO_FIRMWARE_NAME:ccimx91 = "mx91a0-ahab-container.img"

BOOTLOADER_SEEK_USERDATA = "32"

KERNEL_DEVICETREE ?= " \
    digi/ccimx91-dvk.dtb \
    digi/ccimx9-dvk_enet2.dtbo \
    digi/ccimx9-dvk_mikroe-accel2-click.dtbo \
    digi/ccimx9-dvk_mikroe-gyro-click.dtbo \
    digi/ccimx9_bt.dtbo \
    digi/ccimx9_bt-dtm.dtbo \
    digi/ccimx9_wifi.dtbo \
    ${@bb.utils.contains('DISTRO_FEATURES', 'tsn', 'digi/ccimx9-dvk_eqos-tsn.dtbo', '', d)} \
"
FIT_CONF_DEFAULT_DTB = "ccimx91-dvk.dtb"

# Default image for install scripts
DEFAULT_IMAGE_NAME ?= "core-image-base"

# Set this platform without graphical support
IS_HEADLESS = "true"

# Boot artifacts to be copied from the deploy dir to the installer ZIP
BOOTABLE_ARTIFACTS = " \
    imx-boot##SIGNED##-ccimx91-dvk.bin \
"

# Add secure enclave
SOC_TOOLS_TEST:append:mx91-nxp-bsp = " imx-secure-enclave"
# Add AFE support
NXPAFE_INSTALL:mx91-nxp-bsp = "nxp-afe nxp-afe-voiceseeker"
```

## meta-digi-arm/conf/machine/ccimx93-dvk.conf
```bitbake
#@TYPE: Machine
#@NAME: ConnectCore 93 Development Kit
#@DESCRIPTION: Machine configuration for Digi's ConnectCore 93 DVK

DIGI_SOM = "ccimx93"
MACHINEOVERRIDES =. "mx93:${DIGI_FAMILY}:${DIGI_SOM}:"

# Include the machine configuration for Digi's ConnectCore 9 module
include conf/machine/include/ccimx9.inc

# U-Boot configurations
UBOOT_CONFIG ??= "ccimx93-dvk"
UBOOT_CONFIG[ccimx93-dvk] = "ccimx93-dvk_defconfig"

# imx-boot configurations
ATF_PLATFORM = "imx93"
IMX_BOOT_SOC_TARGET = "iMX93"
IMXBOOT_TARGETS = "flash_singleboot flash_singleboot_a0"
# Generate images for all SOC revisions (keep the override as otherwise the
# one in "use-imx-security-controller-firmware.bbclass" takes precedence)
SECO_FIRMWARE_NAME:ccimx93 = "mx93??-ahab-container.img"

KERNEL_DEVICETREE ?= " \
    digi/ccimx93-dvk.dtb \
    digi/_ov_board_dlc0200ccp04df-mipi-dsi_ccimx93-dvk.dtbo \
    digi/_ov_board_lvds_ccimx93-dvk.dtbo \
    digi/_ov_board_enet2_ccimx9-dvk.dtbo \
    digi/_ov_board_mikroe-accel2-click_ccimx9-dvk.dtbo \
    digi/_ov_board_mikroe-gyro-click_ccimx9-dvk.dtbo \
    digi/_ov_som_bt_ccimx9.dtbo \
    digi/_ov_som_bt-dtm_ccimx9.dtbo \
    digi/_ov_som_npu_ccimx93.dtbo \
    digi/_ov_som_wifi_ccimx9.dtbo \
    ${@bb.utils.contains('DISTRO_FEATURES', 'tsn', 'digi/_ov_board_eqos-tsn_ccimx9-dvk.dtbo', '', d)} \
"

# Add additional firmware
MACHINE_FIRMWARE:append = " ethos-u-firmware"

IMAGE_BOOT_FILES:append:use-nxp-bsp = " \
    imx93_m33_TCM_rpmsg_lite_pingpong_rtos_linux_remote.bin \
    imx93_m33_TCM_rpmsg_lite_str_echo_rtos.bin \
"
WKS_FILE_DEPENDS:append = " imx-m33-demos"

# Boot artifacts to be copied from the deploy dir to the installer ZIP
BOOTABLE_ARTIFACTS = " \
    imx-boot-ccimx93-dvk.bin \
    imx-boot-ccimx93-dvk-A0.bin \
"
```

## meta-digi-arm/conf/machine/ccimx95-dvk.conf
```bitbake
#@TYPE: Machine
#@NAME: ConnectCore 95 Development Kit
#@DESCRIPTION: Machine configuration for Digi's ConnectCore 95 DVK

DIGI_SOM = "ccimx95"
MACHINEOVERRIDES =. "mx95:${DIGI_FAMILY}:${DIGI_SOM}:"

# Include the machine configuration for Digi's ConnectCore 9 module
include conf/machine/include/ccimx9.inc

# XBEE
XBEE_RESET_N_GPIO = "43840000.gpio@21"

# U-Boot configurations
UBOOT_CONFIG ??= "ccimx95-dvk"
UBOOT_CONFIG[ccimx95-dvk] = "ccimx95-dvk_defconfig"

# Index of USB device for installer
UBOOT_INSTALL_USB_INDEX = "0"
# Index of microSD device for installer
UBOOT_INSTALL_SD_INDEX = "1"

# imx-boot configurations
ATF_PLATFORM = "imx95"
IMX_BOOT_SOC_TARGET = "iMX95"
IMXBOOT_TARGETS = "flash_all flash_a55"
SYSTEM_MANAGER_CONFIG ?= "ccimx95dvk"
SYSTEM_MANAGER_FIRMWARE_BASENAME ?= "m33_image"
SYSTEM_MANAGER_FIRMWARE_NAME     ?= "${SYSTEM_MANAGER_FIRMWARE_BASENAME}-${SYSTEM_MANAGER_CONFIG}"

OEI_CONFIGS = "ddr tcm"
OEI_CORE   = "m33"
OEI_SOC    = "mx95"
OEI_BOARD  ?= "ccimx95"
DDR_TYPE   ?= "lpddr5"

DDR_FIRMWARE_NAME = " \
    lpddr5_dmem_v202409.bin \
    lpddr5_dmem_qb_v202409.bin \
    lpddr5_imem_v202409.bin \
    lpddr5_imem_qb_v202409.bin \
"

KERNEL_DEVICETREE ?= " \
    digi/ccimx95-dvk.dtb \
    digi/ccimx95-dvk_enet2.dtbo \
    digi/ccimx95-dvk_lvds0_g101evn010.dtbo \
    digi/ccimx95-dvk_lvds1_g101evn010.dtbo \
    digi/ccimx95-dvk_mikroe-accel2-click.dtbo \
    digi/ccimx95-dvk_mikroe-gyro-click.dtbo \
    digi/ccimx95-dvk_pcam5c.dtbo \
    digi/ccimx9_bt.dtbo \
    digi/ccimx9_bt-dtm.dtbo \
    digi/ccimx9_wifi.dtbo \
"
FIT_CONF_DEFAULT_DTB = "ccimx95-dvk.dtb"

# Default image for install scripts
DEFAULT_IMAGE_NAME ?= "dey-image-chromium"

# Boot artifacts to be copied from the deploy dir to the installer ZIP
BOOTABLE_ARTIFACTS = " \
    imx-boot##SIGNED##-ccimx95-dvk.bin \
"
```
