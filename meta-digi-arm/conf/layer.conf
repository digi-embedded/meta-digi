## meta-digi-arm/conf/layer.conf
```bitbake
# We have a conf and classes directory, add to BBPATH
BBPATH .= ":${LAYERDIR}"

# We have a packages directory, add to BBFILES
BBFILES += "${LAYERDIR}/recipes-*/*/*.bb \
            ${LAYERDIR}/recipes-*/*/*.bbappend"

BBFILE_COLLECTIONS += "digi-arm"
BBFILE_PATTERN_digi-arm := "^${LAYERDIR}/"
BBFILE_PRIORITY_digi-arm = "5"

BBFILES_DYNAMIC += " \
    freescale-layer:${LAYERDIR}/dynamic-layers/freescale-layer/*/*/*.bb \
    freescale-layer:${LAYERDIR}/dynamic-layers/freescale-layer/*/*/*.bbappend \
    stm-st-stm32mp:${LAYERDIR}/dynamic-layers/stm-st-stm32mp/*/*/*.bb \
    stm-st-stm32mp:${LAYERDIR}/dynamic-layers/stm-st-stm32mp/*/*/*.bbappend \
    wolfssl:${LAYERDIR}/dynamic-layers/wolfssl/*/*/*.bb \
    wolfssl:${LAYERDIR}/dynamic-layers/wolfssl/*/*/*.bbappend \
"

LAYERDEPENDS_digi-arm = "core"
LAYERDEPENDS_digi-arm += "${@oe.utils.conditional('DEY_SOC_VENDOR', 'NXP', 'freescale-layer', '', d)}"
LAYERDEPENDS_digi-arm += "${@oe.utils.conditional('DEY_SOC_VENDOR', 'STM', 'stm-st-stm32mp', '', d)}"

LAYERSERIES_COMPAT_digi-arm = "kirkstone"

# Define new EULAs and add them to the list defined in meta-freescale.
# See fsl-eula-unpack.bbclass.
FSL_EULA_FILE_MD5SUM_LA_OPT_NXP_SOFTWARE_LICENSE_V42 = "ea25d099982d035af85d193c88a1b479"
FSL_EULA_FILE_MD5SUM_LA_OPT_NXP_SOFTWARE_LICENSE_V45 = "63a38e9f392d8813d6f1f4d0d6fbe657"
FSL_EULA_FILE_MD5SUM_LA_OPT_NXP_SOFTWARE_LICENSE_V48 = "db4762b09b6bda63da103963e6e081de"
FSL_EULA_FILE_MD5SUM_LA_OPT_NXP_SOFTWARE_LICENSE_V49 = "2827219e81f28aba7c6a569f7c437fa7"
FSL_EULA_FILE_MD5SUMS:append = " \
    ${FSL_EULA_FILE_MD5SUM_LA_OPT_NXP_SOFTWARE_LICENSE_V42} \
    ${FSL_EULA_FILE_MD5SUM_LA_OPT_NXP_SOFTWARE_LICENSE_V45} \
    ${FSL_EULA_FILE_MD5SUM_LA_OPT_NXP_SOFTWARE_LICENSE_V48} \
    ${FSL_EULA_FILE_MD5SUM_LA_OPT_NXP_SOFTWARE_LICENSE_V49} \
"

# STM EULA
EULA_FILE_ST_${MACHINE} = "${LAYERDIR}/conf/eula/${MACHINE}"
EULA_FILE_ST_MD5SUM_${MACHINE} = "8b505090fb679839cefbcc784afe8ce9"

# Ignore some STM recipes
BBMASK += " \
    meta-st-stm32mp/recipes-bsp/alsa/alsa-state-stm32mp1.bb \
    meta-st-stm32mp/recipes-core/base-files/base-files_%.bbappend \
    meta-st-stm32mp/recipes-core/busybox/busybox_%.bbappend \
    meta-st-stm32mp/recipes-core/systemd/systemd-conf_%.bbappend \
    meta-st-stm32mp/recipes-kernel/linux/linux-stm32mp_5.15.bb \
"

# Tweak stm32mpu-ai dependencies to use ST's machine learning packages
LAYERDEPENDS_stm32mpu-ai:remove = "st-openstlinux"
BBMASK += " \
    meta-st-stm32mpu-ai/recipes-st/images/st-image-ai-userfs.bb \
    meta-st-stm32mpu-ai/recipes-st/images/st-image-ai.bb \
"

# Digi's General and Open Source license agreements
DIGI_EULA_FILE = "${LAYERDIR}/DIGI_EULA"
DIGI_OPEN_EULA_FILE = "${LAYERDIR}/DIGI_OPEN_EULA"

# Additional license directories
LICENSE_PATH += "${LAYERDIR}/custom-licenses"

DIGI_MTK_GIT ?= "git://stash.digi.com"
DIGI_PKG_SRC ?= "https://ftp1.digi.com/support/digiembeddedyocto/source"
DIGI_GITHUB_GIT ?= "git://github.com/digi-embedded"

# Disable CVE report generation by default
do_vigiles_check[noexec] = "1"
```

## meta-digi-arm/conf/machine/ccardimx28js.conf
```bitbake
#@TYPE: Machine
#@NAME: ConnectCore for MX28 JumpStart Kit.
#@DESCRIPTION: Machine configuration for Digi's ConnectCore for MX28 JSK. 

include conf/machine/include/ccardimx28.inc

IMXBOOTLETS_MACHINE = "CCARDIMX28JS"

# U-Boot configurations
UBOOT_CONFIG ??= "ccardimx28js"
UBOOT_CONFIG[ccardimx28js] = "ccardimx28js_config"
# Only for u-boot 'v2009.08':
UBOOT_CONFIG[ccardimx28js_261MHz] = "ccardimx28js_261MHz_config"
UBOOT_CONFIG[ccardimx28js_360MHz] = "ccardimx28js_360MHz_config"

KERNEL_DEVICETREE = "imx28-${MACHINE}.dtb"

# Serial console
SERIAL_CONSOLES = "115200;ttyAMA0"

# Bluetooth tty
BT_TTY ?= "ttyAPP0"

# U-Boot script to be copied to the SD image
BOOT_SCRIPTS = "boot.scr:boot.scr"

# Flash image types
IMAGE_FSTYPES ?= "jffs2.sum sdcard tar.bz2 ubifs"

# FLASH parameters
MKUBIFS_ARGS ?= "-m 2048 -e 126976 -c 2047"
EXTRA_IMAGECMD_jffs2 ?= "-l -e 128 -n"
JFFS2_SUM_EXTRA_ARGS ?= "${EXTRA_IMAGECMD_jffs2}"
```

## meta-digi-arm/conf/machine/ccardxmx28js.conf
```bitbake
#@TYPE: Machine
#@NAME: ConnectCore for MX28 JumpStart Kit.
#@DESCRIPTION: Machine configuration for Digi's ConnectCore for MX28 JSK. 

include conf/machine/include/mxs-digi-base.inc

UBOOT_ENTRYPOINT = "0x41008000"
UBOOT_LOADADDRESS = "0x41008000"
UBOOT_MACHINE = "ccardxmx28js_config"
UBOOT_MAKE_TARGET = "u-boot-ivt.sb"
UBOOT_SUFFIX = "sb"
UBOOT_IMAGE = "u-boot-${MACHINE}-ivt-${PV}-${PR}.${UBOOT_SUFFIX}"
UBOOT_BINARY = "u-boot-ivt.${UBOOT_SUFFIX}"
UBOOT_SYMLINK = "u-boot-${MACHINE}-ivt.${UBOOT_SUFFIX}"

KERNEL_IMAGETYPE = "uImage"

# Digi's kernel does not use device tree.
# KERNEL_DEVICETREE = "${S}/arch/arm/boot/dts/ccardxmx28js.dts"

MACHINE_ESSENTIAL_EXTRA_RDEPENDS += "kernel-module-atheros"

SERIAL_CONSOLE = "115200 ttyAM0"

KERNEL_IMAGETYPE = "uImage"

MACHINE_FEATURES = "apm usbgadget usbhost vfat alsa touchscreen bluetooth wifi"

MACHINE_FIRMWARE += "firmware-mxs-ar3k"
```

## meta-digi-arm/conf/machine/ccimx51js.conf
```bitbake
#@TYPE: Machine
#@NAME: ConnectCore for MX51 JumpStart Kit.
#@DESCRIPTION: Machine configuration for Digi's ConnectCore for MX51 JSK

include conf/machine/include/ccimx51.inc

SERIAL_CONSOLES = "38400;ttymxc1"

# Per-variant FLASH parameters
MKUBIFS_ARGS ?= "-m 2048 -e 129024 -c 4095"
MKUBIFS_ARGS_agv4k ?= "-m 4096 -e 520192 -c 1023"
MKUBIFS_ARGS_eagv4k ?= "-m 4096 -e 520192 -c 1023"
EXTRA_IMAGECMD_jffs2 ?= "-l -e 128 -n"
EXTRA_IMAGECMD_jffs2_agv4k ?= "-l -e 512 -n"
EXTRA_IMAGECMD_jffs2_eagv4k ?= "-l -e 512 -n"
JFFS2_SUM_EXTRA_ARGS ?= "${EXTRA_IMAGECMD_jffs2}"
```

## meta-digi-arm/conf/machine/ccimx53js.conf
```bitbake
#@TYPE: Machine
#@NAME: ConnectCore for MX53 JumpStart Kit.
#@DESCRIPTION: Machine configuration for Digi's ConnectCore for MX53 JSK.

# Contains the ConnectCore for MX53 module.
include conf/machine/include/ccimx53.inc

SERIAL_CONSOLES = "115200;ttymxc0"

# Flash image types
IMAGE_FSTYPES ?= "jffs2.sum tar.bz2 ubifs"

# Per-variant FLASH parameters
MKUBIFS_ARGS ?= "-m 2048 -e 129024 -c 4095"
MKUBIFS_ARGS_4k ?= "-m 4096 -e 520192 -c 1023"
MKUBIFS_ARGS_e4k ?= "-m 4096 -e 520192 -c 1023"
EXTRA_IMAGECMD_jffs2 ?= "-l -e 128 -n"
EXTRA_IMAGECMD_jffs2_4k ?= "-l -e 512 -n"
EXTRA_IMAGECMD_jffs2_e4k ?= "-l -e 512 -n"
JFFS2_SUM_EXTRA_ARGS ?= "${EXTRA_IMAGECMD_jffs2}"
```

## meta-digi-arm/conf/machine/ccimx6adpt.conf
```bitbake
#@TYPE: Machine
#@NAME: ConnectCore 6 JumpStart Kit.
#@DESCRIPTION: Machine configuration for Digi's ConnectCore 6 JSK.

# Contains the ConnectCore 6 module.
include conf/machine/include/ccimx6.inc

KERNEL_DEVICETREE = "imx6q-${MACHINE}.dtb"

SERIAL_CONSOLES = "115200;ttymxc0"

# U-Boot script to be copied to the SD image
BOOT_SCRIPTS = "boot-sd.scr:boot.scr"

#
# Partition sizes
# ---------------
# boot:    64 MiB
# system: 512 MiB
#
BOARD_BOOTIMAGE_PARTITION_SIZE ?= "67108864"
```

## meta-digi-arm/conf/machine/ccimx6qpsbc.conf
```bitbake
#@TYPE: Machine
#@NAME: ConnectCore 6 QuadPlus Single Board Computer.
#@DESCRIPTION: Machine configuration for Digi's ConnectCore 6 QuadPlus SBC.

DIGI_SOM = "ccimx6qp"

# Include the machine configuration for Digi's ConnectCore 6 module.
include conf/machine/include/ccimx6.inc

# Wireless external module
WIRELESS_MODULE:append = " ${@oe.utils.conditional('HAVE_WIFI', '1', 'kernel-module-qualcomm', '', d)}"
HAS_WIFI_VIRTWLANS = "true"

# Wireless p2p interface
WLAN_P2P_DEVICE_NAME ?= "ccimx6qp-p2p"

MACHINE_FEATURES += "cryptochip"

# Firmware
MACHINE_FIRMWARE:append = " ${@oe.utils.conditional('HAVE_BT', '1', 'firmware-qualcomm-qca6564-bt', '', d)}"
MACHINE_FIRMWARE:append = " ${@oe.utils.conditional('HAVE_WIFI', '1', 'firmware-qualcomm-qca6564-wifi', '', d)}"

# U-Boot configurations
# Last one is the default (the one the symlinks point at)
UBOOT_CONFIG ??= "ccimx6qpsbc1GB ccimx6qpsbc2GB"
UBOOT_CONFIG[ccimx6qpsbc1GB] = "ccimx6qpsbc1GB_defconfig,,u-boot-dtb.${UBOOT_SUFFIX}"
UBOOT_CONFIG[ccimx6qpsbc2GB] = "ccimx6qpsbc2GB_defconfig,,u-boot-dtb.${UBOOT_SUFFIX}"

BOOTLOADER_SEEK_BOOT = "1"

KERNEL_DEVICETREE ?= " \
    imx6qp-ccimx6qpsbc.dtb \
    imx6qp-ccimx6qpsbc-id160.dtb \
    imx6qp-ccimx6qpsbc-wb.dtb \
"

SERIAL_CONSOLES ?= "115200;ttymxc3"

# Bluetooth interface
BT_DEVICE_NAME ?= "cc6qp"

# Bluetooth tty
BT_TTY ?= "ttymxc1"

# XBee
XBEE_TTY ?= "ttymxc4"

# Image FS types
IMAGE_FSTYPES ?= '${@bb.utils.contains("IMAGE_FEATURES", "read-only-rootfs", \
				       "boot.vfat tar.bz2 recovery.vfat squashfs", \
				       "boot.vfat ext4.gz sdcard.gz tar.bz2 recovery.vfat", d)}'

# Boot artifacts to be copied from the deploy dir to the installer ZIP
BOOTABLE_ARTIFACTS = " \
    u-boot-ccimx6qpsbc1GB.imx \
    u-boot-ccimx6qpsbc2GB.imx \
"

# Default overlayfs_etc mount point and type
OVERLAYFS_ETC_MOUNT_POINT ?= "/mnt/data"
OVERLAYFS_ETC_DEVICE ?= "/dev/mmcblk0p7"
OVERLAYFS_ETC_FSTYPE ?= "ext4"
```

## meta-digi-arm/conf/machine/ccimx6sbc.conf
```bitbake
#@TYPE: Machine
#@NAME: ConnectCore 6 Single Board Computer.
#@DESCRIPTION: Machine configuration for Digi's ConnectCore 6 SBC.

# Contains the ConnectCore 6 module.
include conf/machine/include/ccimx6.inc

# Wireless external module
WIRELESS_MODULE_append = " ${@oe.utils.conditional('HAVE_WIFI', '1', 'kernel-module-qualcomm', '', d)}"
HAS_WIFI_VIRTWLANS = "true"

# Firmware
MACHINE_FIRMWARE_append = " ${@oe.utils.conditional('HAVE_BT', '1' , 'firmware-atheros-ar3k firmware-qualcomm-qca6564-bt', '', d)}"
MACHINE_FIRMWARE_append = " ${@oe.utils.conditional('HAVE_WIFI', '1' , 'firmware-atheros-ath6kl firmware-qualcomm-qca6564-wifi', '', d)}"

PREFERRED_PROVIDER_virtual/libg2d_mx6 = "imx-gpu-g2d"

# U-Boot configurations
# Last one is the default (the one the symlinks point at)
UBOOT_CONFIG ??= "ccimx6dlsbc512MB ccimx6dlsbc ccimx6qsbc2GB ccimx6qsbc512MB ccimx6qsbc"
UBOOT_CONFIG[ccimx6dlsbc512MB] = "ccimx6dlsbc512MB_defconfig,,u-boot-dtb.${UBOOT_SUFFIX}"
UBOOT_CONFIG[ccimx6dlsbc] = "ccimx6dlsbc_defconfig,,u-boot-dtb.${UBOOT_SUFFIX}"
UBOOT_CONFIG[ccimx6qsbc2GB] = "ccimx6qsbc2GB_defconfig,,u-boot-dtb.${UBOOT_SUFFIX}"
UBOOT_CONFIG[ccimx6qsbc512MB] = "ccimx6qsbc512MB_defconfig,,u-boot-dtb.${UBOOT_SUFFIX}"
UBOOT_CONFIG[ccimx6qsbc] = "ccimx6qsbc_defconfig,,u-boot-dtb.${UBOOT_SUFFIX}"

KERNEL_DEVICETREE ?= " \
    imx6dl-ccimx6sbc.dtb \
    imx6dl-ccimx6sbc-w.dtb \
    imx6dl-ccimx6sbc-wb.dtb \
    imx6q-ccimx6sbc.dtb \
    imx6q-ccimx6sbc-w.dtb \
    imx6q-ccimx6sbc-wb.dtb \
    imx6q-ccimx6sbc-wb-ldo-bypass.dtb \
    imx6q-ccimx6sbc-id129.dtb \
    imx6q-ccimx6sbc-id130.dtb \
    imx6dl-ccimx6sbc-id131.dtb \
"

SERIAL_CONSOLES ?= "115200;ttymxc3"

# Bluetooth tty
BT_TTY ?= "ttymxc1"

# XBee
XBEE_TTY ?= "ttymxc4"

# Flash image types
IMAGE_FSTYPES ?= "boot.vfat ext4.gz sdcard.gz tar.bz2 recovery.vfat"
# Add SQUASHFS if read-only-rootfs is enabled
IMAGE_FSTYPES += '${@bb.utils.contains("IMAGE_FEATURES", "read-only-rootfs", "squashfs", "", d)}'
```

## meta-digi-arm/conf/machine/ccimx6ulsbc.conf
```bitbake
#@TYPE: Machine
#@NAME: SBC for ConnectCore for i.MX6UL
#@DESCRIPTION: Machine configuration for Digi's ConnectCore 6UL SBC.

# Include the machine configuration for Digi's ConnectCore 6UL.
include conf/machine/include/ccimx6ul.inc

# U-Boot configurations
# Last one is the default (the one the symlinks point at)
UBOOT_CONFIG ??= "ccimx6ulsbc1GB ccimx6ulsbc512MB ccimx6ulsbc"
UBOOT_CONFIG[ccimx6ulsbc1GB] = "ccimx6ulsbc1GB_defconfig,,u-boot-dtb.${UBOOT_SUFFIX}"
UBOOT_CONFIG[ccimx6ulsbc512MB] = "ccimx6ulsbc512MB_defconfig,,u-boot-dtb.${UBOOT_SUFFIX}"
UBOOT_CONFIG[ccimx6ulsbc] = "ccimx6ulsbc_defconfig,,u-boot-dtb.${UBOOT_SUFFIX}"

KERNEL_DEVICETREE ?= " \
    imx6ul-ccimx6ulsbc.dtb \
    imx6ul-ccimx6ulsbc-wb.dtb \
    imx6ul-ccimx6ulsbc-id135.dtb \
    imx6ul-ccimx6ulsbc-id136.dtb \
"
KERNEL_DEVICETREE:use-mainline-bsp ?= "imx6ul-ccimx6ulsbcpro.dtb"

KERNEL_DEFCONFIG ?= "arch/arm/configs/ccimx6ul_defconfig"

SERIAL_CONSOLES ?= "115200;ttymxc4"

# Bluetooth tty
BT_TTY ?= "ttymxc0"

# XBee
XBEE_TTY ?= "ttymxc1"

# Image FS types
IMAGE_FSTYPES ?= '${@bb.utils.contains("IMAGE_FEATURES", "read-only-rootfs", \
				       "tar.bz2 boot.ubifs recovery.ubifs squashfs", \
				       "tar.bz2 ubifs boot.ubifs recovery.ubifs", d)}'

# Boot artifacts to be copied from the deploy dir to the installer ZIP
BOOTABLE_ARTIFACTS = " \
    u-boot-ccimx6ulsbc1GB.imx \
    u-boot-ccimx6ulsbc512MB.imx \
    u-boot-ccimx6ulsbc.imx \
"
```

## meta-digi-arm/conf/machine/ccimx6ulstarter.conf
```bitbake
#@TYPE: Machine
#@NAME: Starter Board for ConnectCore for i.MX6UL
#@DESCRIPTION: Machine configuration for Digi's ConnectCore 6UL Starter Board.

# Include the machine configuration for Digi's ConnectCore 6UL.
include conf/machine/include/ccimx6ul.inc

# U-Boot configurations
# Last one is the default (the one the symlinks point at)
UBOOT_CONFIG ??= "ccimx6ulstarter1GB ccimx6ulstarter512MB ccimx6ulstarter"
UBOOT_CONFIG[ccimx6ulstarter1GB] = "ccimx6ulstarter1GB_defconfig,,u-boot-dtb.${UBOOT_SUFFIX}"
UBOOT_CONFIG[ccimx6ulstarter512MB] = "ccimx6ulstarter512MB_defconfig,,u-boot-dtb.${UBOOT_SUFFIX}"
UBOOT_CONFIG[ccimx6ulstarter] = "ccimx6ulstarter_defconfig,,u-boot-dtb.${UBOOT_SUFFIX}"
# Index of USB device for installer
UBOOT_INSTALL_USB_INDEX = "0"
# Index of microSD device for installer
UBOOT_INSTALL_SD_INDEX = "0"

KERNEL_DEVICETREE ?= " \
    digi/imx6ul-ccimx6ulstarter.dtb \
    digi/imx6ul-ccimx6ulstarter-wb.dtb \
    digi/imx6ul-ccimx6ulstarter-id129.dtb \
"
KERNEL_DEVICETREE:use-mainline-bsp ?= "imx6ul-ccimx6ulsbcexpress.dtb"

KERNEL_DEFCONFIG ?= "arch/arm/configs/ccimx6ul_defconfig"

SERIAL_CONSOLES ?= "115200;ttymxc4"

# Bluetooth tty
BT_TTY ?= "ttymxc0"

# Default image for install scripts
DEFAULT_IMAGE_NAME ?= "core-image-base"

# Boot artifacts to be copied from the deploy dir to the installer ZIP
BOOTABLE_ARTIFACTS = " \
    u-boot##SIGNED##-ccimx6ulstarter1GB.imx \
    u-boot##SIGNED##-ccimx6ulstarter512MB.imx \
    u-boot##SIGNED##-ccimx6ulstarter.imx \
"
```

## meta-digi-arm/conf/machine/ccimx8mm-dvk.conf
```bitbake
#@TYPE: Machine
#@NAME: ConnectCore 8M Mini Development Kit.
#@DESCRIPTION: Machine configuration for Digi's ConnectCore 8M Mini DVK.

DIGI_FAMILY = "ccimx8mm"
MACHINEOVERRIDES =. "mx8:mx8m:mx8mm:ccimx8m:${DIGI_FAMILY}:"

# Include the machine configuration for Digi's ConnectCore 8M module.
include conf/machine/include/ccimx8m.inc

BOOTLOADER_SEEK_USERDATA = "33"
BOOTLOADER_SEEK_BOOT = "0"

# U-Boot configurations
#
# At the moment config label should be "machine" because SDIMG_BOOTLOADER
# expects a boot artifact named after machine to create the sdcard image.
UBOOT_CONFIG ??= "ccimx8mm-dvk"
UBOOT_CONFIG[ccimx8mm-dvk] = "ccimx8mm_dvk_defconfig"
SPL_BINARY = "spl/u-boot-spl.bin"

# Set u-boot DTB
UBOOT_DTB_NAME = "ccimx8mm-dvk.dtb"

ATF_PLATFORM = "imx8mm"
IMX_BOOT_SOC_TARGET = "iMX8MM"

KERNEL_DEVICETREE ?= " \
    digi/ccimx8mm-dvk.dtb \
    digi/_ov_board_flexspi_ccimx8m-dvk.dtbo \
    digi/_ov_board_gpio-watchdog_ccimx8m-dvk.dtbo \
    digi/_ov_board_hsd101pfw2-lvds_ccimx8m-dvk.dtbo \
    digi/_ov_board_lvds_ccimx8m-dvk.dtbo \
    digi/_ov_board_user-leds_ccimx8m-dvk.dtbo \
    digi/_ov_som_bt_ccimx8m.dtbo \
    digi/_ov_som_mca-keypad_ccimx8m.dtbo \
    digi/_ov_som_wifi_ccimx8m.dtbo \
"

SERIAL_CONSOLES ?= "115200;ttymxc0"

# Bluetooth tty
BT_TTY ?= "ttymxc1"

# XBees
XBEE_RESET_N_GPIO ?= "mca-gpio@15,gpio1@8"
XBEE_SLEEP_RQ_GPIO ?= "mca-gpio@11,gpio1@7"
XBEE_TTY ?= "ttymxc3"

# Image FS types
IMAGE_FSTYPES ?= '${@bb.utils.contains("IMAGE_FEATURES", "read-only-rootfs", \
				       "boot.vfat tar.bz2 recovery.vfat squashfs", \
				       "boot.vfat ext4.gz sdcard.gz tar.bz2 recovery.vfat", d)}'

# Boot artifacts to be copied from the deploy dir to the installer ZIP
BOOTABLE_ARTIFACTS = "imx-boot-ccimx8mm-dvk.bin"
```
