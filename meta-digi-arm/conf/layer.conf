## meta-digi-arm/conf/machine/ccmp25-dvk.conf
```bitbake
#@TYPE: Machine
#@NAME: ccmp25-dvk
#@DESCRIPTION: Configuration for Digi ConnectCore MP25 DVK
#@NEEDED_BSPLAYERS: layers/meta-digi

# Include the machine configuration for Digi's ConnectCore MP2.
include conf/machine/include/ccmp2.inc

# Define specific familly common machine name
DIGI_SOM = "ccmp25"
MACHINEOVERRIDES =. "stm32mp2common:stm32mp25common:${DIGI_FAMILY}:${DIGI_SOM}:"

# =========================================================================
# Chip architecture
# =========================================================================
DEFAULTTUNE = "cortexa35"
include conf/machine/include/arm/armv8a/tune-cortexa35.inc

# =========================================================================
# boot device
# =========================================================================
# Configure the list of boards that enable EMMC/SDCARD
DEVICE_BOARD_ENABLE:EMMC   += "${STM32MP_DEVICETREE}"
DEVICE_BOARD_ENABLE:SDCARD += "${@bb.utils.contains('BOOTDEVICE_LABELS', 'sdcard', '${STM32MP_DEVICETREE}', '', d)}"

# =========================================================================
# U-Boot configs
# =========================================================================
# Remove STM32mp25 configs from ST layer
UBOOT_CONFIG:remove:stm32mp25common = " default_stm32mp25 "
# Last one is the default (the one the symlinks point at)
UBOOT_CONFIG = "ccmp25-dvk"
UBOOT_CONFIG[ccmp25-dvk] = "ccmp25-dvk_defconfig,,u-boot.dtb"
# List of U-Boot device tree to use
UBOOT_DEVICETREE = "${STM32MP_DEVICETREE}"
# Index of USB device for installer
UBOOT_INSTALL_USB_INDEX = "0"
# Index of microSD device for installer
UBOOT_INSTALL_SD_INDEX = "2"

# =========================================================================
# Machine settings
# =========================================================================
# Define list of devicetree per supported storage
STM32MP_DT_FILES_EMMC = "ccmp25-dvk"
STM32MP_DT_FILES_SDCARD = "${STM32MP_DT_FILES_EMMC}"
STM32MP_DT_FILES_USB = "${STM32MP_DT_FILES_EMMC}"

# Extra files for the board must be specified while ensuring the main DTB
# file for FIT image generation remains the first item.
STM32MP_KERNEL_DEVICETREE:ccmp25-dvk += " \
    ccmp25-dvk.dtb \
    ccmp25_bt.dtbo \
    ccmp25_wifi.dtbo \
    ccmp25-dvk_e55rb-i-mw346-c-mipi-dsi.dtbo \
    ccmp25-dvk_g101evn010-lvds.dtbo \
    ccmp25-dvk_ov5640-mipi-csi.dtbo \
    ccmp25-dvk_mikroe-accel2-click.dtbo \
    ccmp25-dvk_mikroe-gyro-click.dtbo \
    ccmp25-dvk_mikroe-i2c-to-spi-click.dtbo \
    ccmp25-dvk_mikroe-mcp2518fd-click.dtbo \
    ccmp25-dvk_n25q256a-spi-nor-flash.dtbo \
    ccmp25-dvk_nhd-3-5-640480ef-msxp-mipi-dsi.dtbo \
    ccmp25-dvk_usb-3-0-typec.dtbo \
"
FIT_CONF_DEFAULT_DTB = "ccmp25-dvk.dtb"

# =========================================================================
# optee
# =========================================================================
# Map OPTEE configuration to device tree list
OPTEE_DEVICETREE_optee = "${STM32MP_DEVICETREE}"

# =========================================================================
# Machine features
# =========================================================================
MACHINE_FEATURES += "splashscreen"
MACHINE_FEATURES += "watchdog"
MACHINE_FEATURES += "bluetooth"
MACHINE_FEATURES += "wifi"
MACHINE_FEATURES += "usbg0"

# GPU
MACHINE_FEATURES += "${@'gpu' if d.getVar('ACCEPT_EULA_'+d.getVar('MACHINE')) == '1' else ''}"
MACHINE_FEATURES += "openvx"
MACHINE_FEATURES += "opencl"
MACHINE_FEATURES += "vulkan"

# M33
MACHINE_FEATURES += "m33copro"

# Disable external dt
EXTERNAL_DT_ENABLED = "0"

# Flashlayout
# No metadata generated and supported for the moment
STM32MP_METADATA_DATA ?= ""

# GPU have vulkan
DISTRO_FEATURES:append = " ${@bb.utils.contains('DISTRO', 'openstlinux-eglfs', '', 'vulkan', d)} "
DISTRO_FEATURES:append = " opencl "

# =========================================================================
# Firmware
# =========================================================================
MACHINE_FIRMWARE:append = " firmware-murata-infineon firmware-murata-infineon-mfgtest"

MACHINE_EXTRA_RRECOMMENDS += " \
    ${MACHINE_FIRMWARE} \
"

# Default image for install scripts
DEFAULT_IMAGE_NAME ?= "dey-image-webkit"

# Wic files
WKS_FILES += " \
    ccmp2-1GB.wks.in \
"

# Wireless external module
HAS_WIFI_VIRTWLANS = "true"

# For populate_sdk, gcc-arm-none-eabi_11 has a libpython3 dependency, so we remove it.
ST_TOOLS_FOR_SDK:remove = "nativesdk-gcc-arm-none-eabi"

# XBee
XBEE_RESET_N_GPIO ?= "GPIOD@6"
XBEE_SLEEP_RQ_GPIO ?= ""
XBEE_TTY ?= "ttySTM2"

# Disable use of vendorfs and userfs partitions
ST_VENDORFS = "0"
ST_USERFS   = "0"

# Boot artifacts to be copied from the deploy dir to the installer ZIP
BOOTABLE_ARTIFACTS = " \
    ${@oe.utils.ifelse(d.getVar('TRUSTFENCE_SIGN') == '1', 'tf-a-ccmp25-dvk-optee-emmc${SIGN_SUFFIX}.stm32', \
                                                           'tf-a-ccmp25-dvk-optee-emmc.stm32')} \
    metadata-ccmp25-dvk.bin \
    ${@oe.utils.ifelse(d.getVar('TRUSTFENCE_SIGN') == '1', 'fip-ccmp25-dvk-optee-emmc${SIGN_SUFFIX}.bin', \
                                                           'fip-ccmp25-dvk-optee-emmc.bin')} \
"

# Per-machine DISTRO_FEATURES customization
MACHINE_DISTRO_FEATURES_ADD = "efi optee"
MACHINE_DISTRO_FEATURES_REMOVE = "x11"

# Default ROOTFS max size for image being built to this value
IMAGE_ROOTFS_MAXSIZE = "2621440"

# Default overlayfs_etc mount point and type
OVERLAYFS_ETC_MOUNT_POINT ?= "/mnt/data"
OVERLAYFS_ETC_DEVICE ?= "/dev/mmcblk0p11"
OVERLAYFS_ETC_FSTYPE ?= "ext4"
```

## meta-digi-arm/conf/machine/ccxmx51js.conf
```bitbake
#@TYPE: Machine
#@NAME: ConnectCore for MX51 JumpStart Kit.
#@DESCRIPTION: Machine configuration for Digi's ConnectCore for MX51 JSK

include conf/machine/include/imx-digi-base.inc
include conf/machine/include/tune-cortexa8.inc

SOC_FAMILY = "mx51:mx5"

# Digi's kernel does not use device trees.
# KERNEL_DEVICETREE = "${S}/arch/arm/boot/dts/ccxmx51js.dts"

UBOOT_MACHINE = "ccxmx51js_config"

MACHINE_FEATURES += " wifi accel-video"

UBOOT_ENTRYPOINT_mx51  = "0x94000000"
UBOOT_LOADADDRESS_mx51 = "0x94000000"

MACHINE_ESSENTIAL_EXTRA_RDEPENDS += "kernel-module-redpine"
```

## meta-digi-arm/conf/machine/ccxmx53js.conf
```bitbake
#@TYPE: Machine
#@NAME: ConnectCore for MX53 JumpStart Kit.
#@DESCRIPTION: Machine configuration for Digi's ConnectCore for MX53 JSK.

include conf/machine/include/imx-digi-base.inc
include conf/machine/include/tune-cortexa8.inc

SOC_FAMILY = "mx53:mx5"

# Digi's kernel does not use device tree.
# KERNEL_DEVICETREE = "${S}/arch/arm/boot/dts/imx53-qsb.dts"

MACHINE_FEATURES += " wifi accel-video"

UBOOT_ENTRYPOINT_mx53  = "0x70800000"
UBOOT_LOADADDRESS_mx53 = "0x70800000"

MACHINE_ESSENTIAL_EXTRA_RDEPENDS += "kernel-module-redpine"
MACHINE_ESSENTIAL_EXTRA_RDEPENDS += "kernel-module-gpio"
```

## meta-digi-arm/conf/machine/cpx2.conf
```bitbake
#@TYPE: Machine
#@NAME: ConnectPort CPX2.
#@DESCRIPTION: Machine configuration for Digi's ConnectPort CPX2. 

include conf/machine/include/mxs-digi-base.inc

SOC_FAMILY = "mxs:mx28"

UBOOT_ENTRYPOINT  = "0x41008000"
UBOOT_LOADADDRESS = "0x41008000"

SERIAL_CONSOLE = "115200 ttyAM0"

# wpa_supplicant driver to use in '/etc/network/interfaces'
WPA_DRIVER = "nl80211"

# Firmware
MACHINE_FIRMWARE = "firmware-mxs-ar3k"
MACHINE_EXTRA_RRECOMMENDS += "${MACHINE_FIRMWARE}"

# MACHINE_FEATURES_append = " wifi"

#################################################
## Flash parameters for JFFS2 and UBIFS images ##
#################################################
#   partition size (KiB)
#   physical eraseblock size (KiB)
#   logical eraseblock size (bytes)
#   minimum input/output size (bytes)
#   sub-page size (bytes)
#
# PEB, LEB, MIO and SUB might be a list of comma-separated values
#
FLASH_PSZ = "262144"
FLASH_PEB = "128"
FLASH_LEB = "126976"
FLASH_MIO = "2048"
FLASH_SUB = "-"
```

## meta-digi-arm/conf/machine/include/ccardimx28.inc
```bitbake
#@TYPE: Machine
#@NAME: ConnectCore for MX28 module.
#@DESCRIPTION: Machine configuration for Digi's ConnectCore for MX28 module.

include conf/machine/include/imx-digi-base.inc
include conf/machine/include/tune-arm926ejs.inc

DIGI_FAMILY = "ccardimx28"
SOC_FAMILY  = "mxs:mx28:${DIGI_FAMILY}"

# Platform u-boot settings
UBOOT_ENTRYPOINT = "0x40008000"
UBOOT_SUFFIX = "sb"
UBOOT_SYMLINK = "u-boot-${MACHINE}.${UBOOT_SUFFIX}"

# Wireless external module
WIRELESS_MODULE ?= ""
WIRELESS_MODULE_append = "${@base_contains('MACHINE_FEATURES', 'wifi', 'kernel-module-atheros', '', d)}"

# Firmware
MACHINE_FIRMWARE ?= ""
MACHINE_FIRMWARE_append = " ${@base_conditional('HAVE_BT', '1' , 'firmware-atheros-ar3k', '', d)}"
MACHINE_FIRMWARE_append = " ${@base_conditional('HAVE_WIFI', '1' , 'firmware-atheros-ath6kl', '', d)}"

MACHINE_EXTRA_RDEPENDS    += "mtd-utils-ubifs nvram ubootenv update-flash"
MACHINE_EXTRA_RRECOMMENDS += "${MACHINE_FIRMWARE} ${WIRELESS_MODULE}"

#
# Supported variants
#
# Maintain in sync with the same table in platform local.conf template.
#
# Name          WiFi    Eth2    BT      1wire
# -------------------------------------------
# -             N       N       N       N       (empty MACHINE_VARIANT="")
# e             N       Y       N       N
# w             Y       N       N       N
# wb            Y       N       Y       N
# web           Y       Y       Y       N
# web1          Y       Y       Y       Y

# Per-variant machine features
MACHINE_FEATURES_append_e = " ext-eth"
MACHINE_FEATURES_append_w = " wifi"
MACHINE_FEATURES_append_wb = " wifi bluetooth"
MACHINE_FEATURES_append_web = " wifi ext-eth bluetooth"
MACHINE_FEATURES_append_web1 = " wifi ext-eth bluetooth 1-wire"
```
