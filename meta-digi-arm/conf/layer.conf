## meta-digi-arm/conf/machine/ccmp13-dvk.conf
```bitbake
#@TYPE: Machine
#@NAME: ccmp13-dvk
#@DESCRIPTION: Configuration for Digi ConnectCore MP13 DVK
#@NEEDED_BSPLAYERS: layers/meta-digi

# Include the machine configuration for Digi's ConnectCore MP1.
include conf/machine/include/ccmp1.inc

DIGI_SOM = "ccmp13"

# =========================================================================
# Chip architecture
# =========================================================================
DEFAULTTUNE = "cortexa7thf-neon-vfpv4"
MACHINEOVERRIDES = "arm:armv7ve:stcommon:stm32mpcommon:stm32mp1common:stm32mp13common:${DIGI_FAMILY}:${DIGI_SOM}:ccmp13-dvk"

# =========================================================================
# boot device
# =========================================================================
# Configure the list of boards that enable NAND/SDCARD
DEVICE_BOARD_ENABLE:NAND   += "${STM32MP_DEVICETREE}"
DEVICE_BOARD_ENABLE:SDCARD += "${@bb.utils.contains('BOOTDEVICE_LABELS', 'sdcard', '${STM32MP_DEVICETREE}', '', d)}"

# =========================================================================
# U-Boot configs
# =========================================================================
# Last one is the default (the one the symlinks point at)
UBOOT_CONFIG = "ccmp13-dvk"
UBOOT_CONFIG[ccmp13-dvk] = "ccmp13-dvk_defconfig,,u-boot.dtb"
# Remove STM32mp13 configs from ST layer
UBOOT_CONFIG:remove:stm32mp13common = "default_stm32mp13"
# List of U-Boot device tree to use
UBOOT_DEVICETREE = "${STM32MP_DEVICETREE}"
# Index of USB device for installer
UBOOT_INSTALL_USB_INDEX = "0"
# Index of microSD device for installer
UBOOT_INSTALL_SD_INDEX = "1"

# =========================================================================
# Machine settings
# =========================================================================
# Define list of devicetree per supported storage
STM32MP_DT_FILES_NAND = "ccmp13-dvk-256MB"
STM32MP_DT_FILES_SDCARD = "${STM32MP_DT_FILES_NAND}"
STM32MP_DT_FILES_USB = "${STM32MP_DT_FILES_NAND}"

# Extra DTB for board - need to specify it with .dtb ...
STM32MP_KERNEL_DEVICETREE:ccmp13-dvk += " \
    ccmp13_bt_test.dtbo \
    ccmp13_bt.dtbo \
    ccmp13_wifi.dtbo \
    ccmp13-dvk_mikroe-accel2-click.dtbo \
    ccmp13-dvk_mikroe-gyro-click.dtbo \
    ccmp13-dvk_mikroe-i2c-to-spi-click.dtbo \
    ccmp13-dvk_pwm8.dtbo \
    ccmp13-dvk_v2.dtbo \
    ccmp13-dvk_v3.dtbo \
    ccmp133-dvk.dtb \
"
FIT_CONF_DEFAULT_DTB = "ccmp133-dvk.dtb"

# =========================================================================
# optee
# =========================================================================
# Map OPTEE configuration to device tree list
OPTEE_DEVICETREE_optee = "${STM32MP_DEVICETREE}"
OPTEE_DEVICETREE_opteemin = "${STM32MP_DEVICETREE}"
# Supported boot schemes
BOOTSCHEME_LABELS ?= "optee"
BOOTSCHEME_DEFAULT ?= "optee"

# =========================================================================
# Machine features
# =========================================================================
MACHINE_FEATURES += "bluetooth"
MACHINE_FEATURES += "wifi"

# =========================================================================
# Firmware
# =========================================================================
MACHINE_FIRMWARE:append = " firmware-murata-infineon"

MACHINE_EXTRA_RRECOMMENDS += " \
    ${MACHINE_FIRMWARE} \
"

# Default image for install scripts
DEFAULT_IMAGE_NAME ?= "core-image-base"

# Wic files
WKS_FILE += "ccmp1-256MB.wks.in"

# For populate_sdk, gcc-arm-none-eabi_9 has a python2 dependency, so we remove it.
ST_TOOLS_FOR_SDK:remove = "nativesdk-gcc-arm-none-eabi"

# =========================================================================
# flashlayout
# =========================================================================
# Define the config labels to use to generate flashlayout file

# =========================================================================
# extlinux configuration
# =========================================================================
# As example, modify the default boot config for each target to M4 config

# =========================================================================
# Debug trace
# =========================================================================
# activate/deactivate the debug and trace on boot stage
ST_DEBUG_TRACE = "0"

# =========================================================================
# Flashlayouts
# =========================================================================

# =========================================================================
# DEY settings
# =========================================================================
IMAGE_CLASSES = "image_types_digi image_types-stubi"

# mkfs.ubifs parameters for boot partition (the one holding kernel and device tree files)
# Max LEB count (-c 255) calculated for a partition of up to 32 MiB considering 128 KiB erase-block size.
MKUBIFS_BOOT_ARGS ?= "-m 2048 -e 126976 -c 255"

# mkfs.ubifs parameters for recovery partition
# Same parameters as the boot partition, but using zlib compression to reduce image size.
MKUBIFS_RECOVERY_ARGS ?= "${MKUBIFS_BOOT_ARGS} -x zlib"

# mkfs.ubifs parameters for rootfs partition
# Max LEB count (-c 8191) calculated for a partition of up to 1 GiB considering 128 KiB erase-block size.
MKUBIFS_ARGS ?= "-m 2048 -e 126976 -c 8191"

# Wireless external module
HAS_WIFI_VIRTWLANS = "true"

# Set this platform without graphical support
IS_HEADLESS = "true"

# XBee
XBEE_RESET_N_GPIO ?= "GPIOG@15"
XBEE_TTY ?= "ttySTM2"

# Per-machine DISTRO_FEATURES customization
MACHINE_DISTRO_FEATURES_ADD = "efi optee"
MACHINE_DISTRO_FEATURES_REMOVE = "gstreamer opengl vulkan wayland x11"

# Disable use of vendorfs partition
ST_VENDORFS = "0"

# Boot artifacts to be copied from the deploy dir to the installer ZIP
BOOTABLE_ARTIFACTS = " \
    ${@oe.utils.ifelse(d.getVar('TRUSTFENCE_SIGN') == '1', 'tf-a-ccmp13-dvk-256MB-${BOOTSCHEME_DEFAULT}-nand${SIGN_SUFFIX}.stm32', \
                                                           'tf-a-ccmp13-dvk-256MB-${BOOTSCHEME_DEFAULT}-nand.stm32')} \
    metadata-ccmp13-dvk.bin \
    ${@oe.utils.ifelse(d.getVar('TRUSTFENCE_SIGN') == '1', 'fip-ccmp13-dvk-256MB-${BOOTSCHEME_DEFAULT}-nand${SIGN_SUFFIX}.bin', \
                                                           'fip-ccmp13-dvk-256MB-${BOOTSCHEME_DEFAULT}-nand.bin')} \
"

# Default overlayfs_etc mount point and type
OVERLAYFS_ETC_MOUNT_POINT ?= "/mnt/data"
OVERLAYFS_ETC_DEVICE ?= "ubi1:data"
OVERLAYFS_ETC_FSTYPE ?= "ubifs"
```

## meta-digi-arm/conf/machine/ccmp15-dvk.conf
```bitbake
#@TYPE: Machine
#@NAME: ccmp15-dvk
#@DESCRIPTION: Configuration for Digi ConnectCore MP15 DVK
#@NEEDED_BSPLAYERS: layers/meta-digi

# Include the machine configuration for Digi's ConnectCore MP1.
include conf/machine/include/ccmp1.inc

DIGI_SOM = "ccmp15"

# =========================================================================
# Chip architecture
# =========================================================================
DEFAULTTUNE = "cortexa7thf-neon-vfpv4"
MACHINEOVERRIDES = "arm:armv7ve:stcommon:stm32mpcommon:stm32mp1common:stm32mp15common:${DIGI_FAMILY}:${DIGI_SOM}:ccmp15-dvk"

# =========================================================================
# boot device
# =========================================================================
# Configure the list of boards that enable NAND/SDCARD
DEVICE_BOARD_ENABLE:NAND   += "${STM32MP_DEVICETREE}"
DEVICE_BOARD_ENABLE:SDCARD += "${@bb.utils.contains('BOOTDEVICE_LABELS', 'sdcard', '${STM32MP_DEVICETREE}', '', d)}"

# =========================================================================
# U-Boot configs
# =========================================================================
# Last one is the default (the one the symlinks point at)
UBOOT_CONFIG = "ccmp15-dvk"
UBOOT_CONFIG[ccmp15-dvk] = "ccmp15-dvk_defconfig,,u-boot.dtb"
# Remove STM32mp15 configs from ST layer
UBOOT_CONFIG:remove:stm32mp15common = "default_stm32mp15"
# List of U-Boot device tree to use
UBOOT_DEVICETREE = "${STM32MP_DEVICETREE}"
# Index of USB device for installer
UBOOT_INSTALL_USB_INDEX = "0"
# Index of microSD device for installer
UBOOT_INSTALL_SD_INDEX = "1"

# =========================================================================
# Machine settings
# =========================================================================
# Define list of devicetree per supported storage
STM32MP_DT_FILES_NAND = "ccmp15-dvk-512MB ccmp15-dvk-1GB"
STM32MP_DT_FILES_SDCARD = "${STM32MP_DT_FILES_NAND}"
STM32MP_DT_FILES_USB = "${STM32MP_DT_FILES_NAND}"

# Extra DTB for board - need to specify it with .dtb ...
STM32MP_KERNEL_DEVICETREE:ccmp15-dvk += " \
    ccmp15_bt_test.dtbo \
    ccmp15_bt.dtbo \
    ccmp15_v1.dtbo \
    ccmp15_wifi.dtbo \
    ccmp15-dvk_can1.dtbo \
    ccmp15-dvk_can2.dtbo \
    ccmp15-dvk_dlc0200ccp04df-mipi-dsi.dtbo \
    ccmp15-dvk_eth0-10-100.dtbo \
    ccmp15-dvk_fusion10-lvds.dtbo \
    ccmp15-dvk_fusion7-parallel.dtbo \
    ccmp15-dvk_g101evn010-lvds.dtbo \
    ccmp15-dvk_mikroe-accel2-click.dtbo \
    ccmp15-dvk_mikroe-gyro-click.dtbo \
    ccmp15-dvk_mikroe-i2c-to-spi-click.dtbo \
    ccmp15-dvk_nhd-3-5-640480ef-msxp-mipi-dsi.dtbo \
    ccmp15-dvk_sv4e-mipi-analyzer.dtbo \
    ccmp15-dvk_v1.dtbo \
    ccmp15-dvk_v2.dtbo \
    ccmp157-dvk.dtb \
"
FIT_CONF_DEFAULT_DTB = "ccmp157-dvk.dtb"

# =========================================================================
# optee
# =========================================================================
# Map OPTEE configuration to device tree list
OPTEE_DEVICETREE_optee = "${STM32MP_DEVICETREE}"
OPTEE_DEVICETREE_opteemin = "${STM32MP_DEVICETREE}"
# Supported boot schemes
BOOTSCHEME_LABELS ?= "opteemin"
BOOTSCHEME_DEFAULT ?= "opteemin"

# =========================================================================
# Machine features
# =========================================================================
MACHINE_FEATURES += "bluetooth"
MACHINE_FEATURES += "wifi"
MACHINE_FEATURES += "gpu"
# When BOOTSCHEME_LABELS is set to "opteemin", optee doesn't get automatically
# added to MACHINE_FEATURES. Add it manually
MACHINE_FEATURES += "optee"

# =========================================================================
# Firmware
# =========================================================================
MACHINE_FIRMWARE:append = " firmware-murata-infineon"

MACHINE_EXTRA_RRECOMMENDS += " \
    ${MACHINE_FIRMWARE} \
"

# Default image for install scripts
DEFAULT_IMAGE_NAME ?= "dey-image-webkit"

# Wic files
WKS_FILES += " \
    ccmp1-512MB.wks.in \
    ccmp1-1GB.wks.in \
"

# For populate_sdk, gcc-arm-none-eabi_9 has a python2 dependency, so we remove it.
ST_TOOLS_FOR_SDK:remove = "nativesdk-gcc-arm-none-eabi"

# =========================================================================
# flashlayout
# =========================================================================
# Define the config labels to use to generate flashlayout file

# =========================================================================
# extlinux configuration
# =========================================================================
# As example, modify the default boot config for each target to M4 config

# =========================================================================
# Debug trace
# =========================================================================
# activate/deactivate the debug and trace on boot stage
ST_DEBUG_TRACE = "0"

# =========================================================================
# Flashlayouts
# =========================================================================

# =========================================================================
# DEY settings
# =========================================================================
IMAGE_CLASSES = "image_types_digi image_types-stubi"

# mkfs.ubifs parameters for boot partition (the one holding kernel and device tree files)
# Max LEB count (-c 255) calculated for a partition of up to 32 MiB considering 128 KiB erase-block size.
MKUBIFS_BOOT_ARGS ?= "-m 2048 -e 126976 -c 255"

# mkfs.ubifs parameters for recovery partition
# Same parameters as the boot partition, but using zlib compression to reduce image size.
MKUBIFS_RECOVERY_ARGS ?= "${MKUBIFS_BOOT_ARGS} -x zlib"

# mkfs.ubifs parameters for rootfs partition
# Max LEB count (-c 8191) calculated for a partition of up to 1 GiB considering 128 KiB erase-block size.
MKUBIFS_ARGS ?= "-m 2048 -e 126976 -c 8191"

# Wireless external module
HAS_WIFI_VIRTWLANS = "true"

# XBee
XBEE_RESET_N_GPIO ?= "GPIOZ@2"
XBEE_TTY ?= "ttySTM2"

# Per-machine DISTRO_FEATURES customization
MACHINE_DISTRO_FEATURES_ADD = "efi optee"
MACHINE_DISTRO_FEATURES_REMOVE = "vulkan x11"

# Disable use of vendorfs partition
ST_VENDORFS = "0"
ST_USERFS   = "0"

# Boot artifacts to be copied from the deploy dir to the installer ZIP
BOOTABLE_ARTIFACTS = " \
    ${@oe.utils.ifelse(d.getVar('TRUSTFENCE_SIGN') == '1', 'tf-a-ccmp15-dvk-512MB-${BOOTSCHEME_DEFAULT}-nand${SIGN_SUFFIX}.stm32', \
                                                           'tf-a-ccmp15-dvk-512MB-${BOOTSCHEME_DEFAULT}-nand.stm32')} \
    ${@oe.utils.ifelse(d.getVar('TRUSTFENCE_SIGN') == '1', 'tf-a-ccmp15-dvk-1GB-${BOOTSCHEME_DEFAULT}-nand${SIGN_SUFFIX}.stm32', \
                                                           'tf-a-ccmp15-dvk-1GB-${BOOTSCHEME_DEFAULT}-nand.stm32')} \
    metadata-ccmp15-dvk.bin \
    ${@oe.utils.ifelse(d.getVar('TRUSTFENCE_SIGN') == '1', 'fip-ccmp15-dvk-512MB-${BOOTSCHEME_DEFAULT}-nand${SIGN_SUFFIX}.bin', \
                                                           'fip-ccmp15-dvk-512MB-${BOOTSCHEME_DEFAULT}-nand.bin')} \
    ${@oe.utils.ifelse(d.getVar('TRUSTFENCE_SIGN') == '1', 'fip-ccmp15-dvk-1GB-${BOOTSCHEME_DEFAULT}-nand${SIGN_SUFFIX}.bin', \
                                                           'fip-ccmp15-dvk-1GB-${BOOTSCHEME_DEFAULT}-nand.bin')} \
"

# Default overlayfs_etc mount point and type
OVERLAYFS_ETC_MOUNT_POINT ?= "/mnt/data"
OVERLAYFS_ETC_DEVICE ?= "ubi1:data"
OVERLAYFS_ETC_FSTYPE ?= "ubifs"
```
